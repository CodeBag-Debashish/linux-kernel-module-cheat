## parsec-benchmark/Config.in
```kconfig
config BR2_PACKAGE_PARSEC_BENCHMARK
	bool "PARSEC_BENCHMARK"
# Parsec shell scripts use a hardcoded /bin/bash
# One option would be to try and use /bin/sh.
# But symlinking fails because of BusyBox' symlink mechanism.
# The other option would be to patch Parsec to use /bin/sh and be POSIX compliant.
# But let's take the path of smallest resistance for now.
	select BR2_PACKAGE_BUSYBOX_SHOW_OTHERS
	select BR2_PACKAGE_BASH
	help
	  Parsec system benchmark.

	  http://parsec.cs.princeton.edu/

if BR2_PACKAGE_PARSEC_BENCHMARK

config BR2_PACKAGE_PARSEC_BENCHMARK_BUILD_LIST
	string "build_list"
	default splash2
	help
	  Space separated list of parsec packages to build.

endif
```
